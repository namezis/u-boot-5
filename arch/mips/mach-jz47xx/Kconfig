## arch/mips/mach-jz47xx/Kconfig
```kconfig
menu "Ingenic JZ47xx platforms"
	depends on ARCH_JZ47XX

config SYS_SOC
	default "jz47xx"

config SOC_JZ4780
	bool
	select SUPPORTS_LITTLE_ENDIAN
	select SUPPORTS_CPU_MIPS32_R1
	select SUPPORTS_CPU_MIPS32_R2
	help
	  Support for Ingenic JZ4780 family SoCs.

config SOC_JZ4760
	bool
	select SUPPORTS_LITTLE_ENDIAN
	select SUPPORTS_CPU_MIPS32_R1
	help
	  Support for Ingenic JZ4760 family SoCs.

choice
	prompt "Board select"

config TARGET_JZ4780_CI20
	bool "Creator CI20 Reference Board"
	select SOC_JZ4780

config TARGET_JZ4760_RS97
	bool "Retro Mini RS97"
	select SOC_JZ4760

endchoice

source "board/imgtec/ci20/Kconfig"
source "board/retromini/rs97/Kconfig"

endmenu
```

## arch/mips/mach-xburst/Kconfig
```kconfig
menu "Ingenic XBurst platform"
	depends on MACH_XBURST

config SYS_SOC
	default "jz4760" if SOC_JZ4760

choice
	prompt "XBurst SoC select"

config SOC_JZ4760
	bool "Ingenic JZ4760"
	select SUPPORTS_CPU_MIPS32_R1
	select SUPPORTS_LITTLE_ENDIAN
	help
	  This supports Ingenic JZ4760 chips

endchoice

choice
	prompt "Board select"

config TARGET_RS97
	bool "Retro Mini RS-97"
	depends on SOC_JZ4760
	help
	  This supports Ingenic JZ4760

endchoice

source "board/retromini/rs97/Kconfig"

endmenu
```

## board/retromini/rs97/Kconfig
```kconfig
if TARGET_JZ4760_RS97

config SYS_BOARD
	default "rs97"

config SYS_VENDOR
	default "retromini"

config SYS_CONFIG_NAME
	default "rs97"

config SYS_TEXT_BASE
	default 0x80004000

endif
```

## configs/rs97_defconfig
```kconfig
CONFIG_MIPS=y
CONFIG_SPL_LDSCRIPT="arch/mips/mach-jz47xx/jz4760/u-boot-spl.lds"
CONFIG_SYS_TEXT_BASE=0x80000200
CONFIG_SPL_GPIO_SUPPORT=y
CONFIG_SPL_LIBGENERIC_SUPPORT=y
CONFIG_SYS_MALLOC_F_LEN=0x2000
CONFIG_SPL_MMC_SUPPORT=y
CONFIG_SPL=y
CONFIG_ARCH_JZ47XX=y
CONFIG_TARGET_JZ4760_RS97=y
CONFIG_DEFAULT_DEVICE_TREE="rs97"
CONFIG_FIT=y
CONFIG_DISPLAY_CPUINFO=y
CONFIG_BOARD_EARLY_INIT_F=y
CONFIG_HUSH_PARSER=y
CONFIG_CMD_MMC=y
CONFIG_CMD_EXT4=y
CONFIG_CMD_FAT=y
# CONFIG_SPL_DOS_PARTITION is not set
# CONFIG_SPL_ISO_PARTITION is not set
CONFIG_OF_EMBED=y
CONFIG_MMC=y
# CONFIG_MMC_HW_PARTITIONING is not set
CONFIG_SPL_MMC_TINY=y
CONFIG_JZ47XX_MMC=y
CONFIG_DM_SERIAL=y
CONFIG_SYS_NS16550=y
CONFIG_USE_TINY_PRINTF=y
CONFIG_SPL_TINY_MEMSET=y
CONFIG_LZO=y
CONFIG_SYS_DCACHE_SIZE=16384
CONFIG_SYS_DCACHE_LINE_SIZE=32
CONFIG_SYS_ICACHE_SIZE=16384
CONFIG_SYS_ICACHE_LINE_SIZE=32
```
